/*
 * Device tree overlay for pl360 on spi0.0
 */

/dts-v1/;
/plugin/;

/ {
	compatible = "brcm,bcm2835", "brcm,bcm2836", "brcm,bcm2708", "brcm,bcm2709";
    /* disable spi-dev for spi0.0 */
    fragment@0 {
        target = <&spi0>;
        __overlay__ {
            status = "okay";
        };
    };

    fragment@1 {
		target = <&spidev0>;
		__overlay__ {
	    	status = "disabled";
		};
	};

	/* the spi config of the pl360 itself binding everything together */
    fragment@2 {
        target = <&spi0>;
        __overlay__ {
            /* needed to avoid dtc warning */
            #address-cells = <1>;
            #size-cells = <0>;
            pl360: pl360@0 {
                reg = <0>;
                compatible = "atmel,pl360";
                pinctrl-names = "default";
                nrst-gpio = <&gpio 1 1>;
				ldo-gpio = <&gpio 20 1>;
				cs-gpio = <&gpio 8 1>;
                spi-max-frequency = <2000000>;
                interrupt-parent = <&gpio>;
                interrupts = <22 0x2>;
                xtal-trim = /bits/ 8 <0x0F>;
            };
        };
    };
};
